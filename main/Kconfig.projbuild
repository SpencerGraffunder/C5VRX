## main/Kconfig.projbuild
```kconfig
config C5VRX_RSSI_METER
    bool "Build standalone ~1 kHz RSSI meter (no video output)"
    default n
    help
        Replace the video pipeline with a race-timer RSSI meter. Boots the
        same proven receive-only RF state (rf_start), tunes to 5800 MHz by
        default (F<mhz> retunes at runtime), and streams RSSI / noise floor
        over USB CDC at ~1 kHz while driving the six-bit video DAC (same
        D4..D9 network, static GPIO writes) with the RSSI level. Excludes
        PARLIO RX, BitScrambler, demodulators, menu and video output, and
        reserves the MAC dump SRAM banks so the background continuous-modem
        dump writer cannot corrupt heap. Video is deliberately sacrificed;
        flash the normal firmware again for picture. See docs/rssi-meter.md.

    if C5VRX_RSSI_METER
        config C5VRX_RSSI_DAC_ENABLE
            bool "Drive the six-bit resistor-ladder RSSI output"
            default y
            help
                Off for boards where the ladder is not fitted, or where the
                ladder pins collide with the console UART. On the ESP32-C5 the
                console UART default pins are GPIO 12 (RX) and GPIO 11 (TX),
                which are DAC bits 3 and 2, so a UART-console build must not
                own them. See docs/rssi-meter.md.

        config C5VRX_RSSI_DAC_OWN_UART_PINS
            bool "Let the ladder own the console UART pins (USB-JTAG console only)"
            default n
            depends on C5VRX_RSSI_DAC_ENABLE
            help
                The tested XIAO ladder is wired to GPIO 23/24/11/12/8/9, so the
                full six-bit network needs the two pins the console UART also
                wants. With this off the meter leaves those bits to the console
                and the UART lead (commands, the 1 kHz stream, the RotorHazard
                serial protocol) works. With this on the ladder is complete and
                the meter is reached only through the board's USB-Serial/JTAG
                port, which the meter always listens on as well.

        config C5VRX_RSSI_BUS
            bool "RX5808 3-wire bus (timer drop-in compatibility)"
            default y
            help
                Receive RX5808-style tuning frames on the SEL/CLK/DATA pins
                (SEL falling starts a 25-bit frame; the host sends address +
                R/W, writes send data, reads get a 20-bit register value
                back). Register 0x1 writes retune, 0x2 all-ones powers the
                receiver down, 0x0 writes reset it, and 0x6/0x7 expose the
                RSSI digitally. See docs/rssi-meter.md.

        config C5VRX_RSSI_BUS_SEL_PIN
            int "RX5808 bus SEL pin"
            default 6
            depends on C5VRX_RSSI_BUS
            range 0 28

        config C5VRX_RSSI_BUS_CLK_PIN
            int "RX5808 bus CLK pin"
            default 4
            depends on C5VRX_RSSI_BUS
            range 0 28

        config C5VRX_RSSI_BUS_DATA_PIN
            int "RX5808 bus DATA pin (bidirectional)"
            default 5
            depends on C5VRX_RSSI_BUS
            range 0 28

        config C5VRX_RSSI_SDM_PIN
            int "Sigma-delta RSSI output pin (-1 = off)"
            default -1
            range -1 28
            help
                Drives the 4 MHz sigma-delta output for an RC-filtered
                analog RSSI pin (~8-bit resolution, see docs/rssi-meter.md
                for the 10k/10k + 100nF wiring). Off by default: never put
                this on the auto-download arm pin (GPIO10) unless that
                circuit is not fitted, the 4 MHz switching would keep the
                MOSFET half-on and hold the BOOT pin low.

        config C5VRX_RSSI_SDM_DIVIDER_M1000
            int "Sigma-delta output divider ratio (milli, 500 = 10k/10k)"
            default 500
            range 100 1000
    endif

menu "C5VRX diagnostic probes"
    config C5VRX_PHY_PHASE_TAP_PROBE
        bool "Capture bounded MODEM_DIAG lane traces at boot, then start video"
        default n
        help
            Capture all 32 MODEM_DIAG lanes under four previously tested
            selector states on the production IQ GPIOs before video starts.
            Restore all selector registers and the normal IQ routing after
            capture. CPU snapshots are asynchronous and cannot alone prove a
            40 MS/s phase tap. This option is for an experimental PR build.

    config C5VRX_BS_RELATIVE_WORKER_PROBE
        bool "Run Counter-A relative-mux loopback oracle before starting video"
        default n
        help
            Run a finite two-bundle BitScrambler loopback test at boot and
            print BS_REL_WORKER PASS/FAIL, then start the normal RF/video path.

    config C5VRX_BS_RELATIVE_MIDDLE_PROBE
        bool "Run alternating middle/endpoint relative-mux loopback probe before starting video"
        default y
        help
            Run a finite two-bundle BitScrambler loopback test at boot to prove
            alternating middle-sample and endpoint-sample Phase5 extraction,
            then start the normal RF/video path.

    config C5VRX_BS_ADDCTIA_PROBE
        bool "Run Counter-A ADDCTIA hardware subtraction loopback probe before starting video"
        default y
        help
            Run a finite BitScrambler loopback test at boot to prove
            single-cycle Counter-A hardware subtraction (ADDCTIAL + LDCTIAL)
            and compact 32-entry DAC lookup for Phase5-360, then start the
            normal RF/video path.
endmenu

menu "C5VRX experimental video demodulators"
    config C5VRX_PHASE8_HR_LIVE_TEST
        bool "Run full-range adjacent Phase8 on live 6BIT@40 video"
        default y
        help
            Experimental full signed Phase8 delta mapping plus Direct Gain V3.
            Maps -128..+127 phase bins across the 64 DAC levels and forces
            6BIT@40 output. A phase step crossing +/-180 degrees still aliases.

    config C5VRX_PHASE5_360_LIVE
        bool "Use Phase5-360 research program (Golden DAC output only)"
        default y
        help
            Load the two-bundle middle-sample routing experiment. Both worker
            branches currently output the same Golden DAC bytes. No adjacent
            winding correction is active in the live firmware.

    config C5VRX_RELATIVE_GOLDEN_LIVE
        bool "Use relative-mux Golden in the live 6-bit video path"
        default n
        help
            Replace only the 6-bit Golden BitScrambler program with the
            two-bundle Counter-A relative-mux oracle. Intended for live
            equivalence testing; no winding correction is performed.
endmenu

config C5VRX_DIRECT_GAIN_V3_EXPERIMENT
    bool "Run predictive Direct Gain V3 on the default automatic RX profile"
    default y
    help
        Experimental issue #107 build. The existing live demodulator stays
        selected, while V3 alone owns automatic RF gain on the default
        profile. Hardware gain and video validation is required before merge.
```
